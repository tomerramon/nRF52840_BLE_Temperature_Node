## CMakeLists.txt
```
cmake_minimum_required(VERSION 3.20.0)
find_package(Zephyr REQUIRED HINTS $ENV{ZEPHYR_BASE})

project(ble_temp_node)

target_sources(app PRIVATE ${CMAKE_CURRENT_SOURCE_DIR}/src/main.c ${CMAKE_CURRENT_SOURCE_DIR}/src/temp_sensor.c ${CMAKE_CURRENT_SOURCE_DIR}/src/app_timer.c ${CMAKE_CURRENT_SOURCE_DIR}/src/ble_service.c)

target_include_directories(app PRIVATE ${CMAKE_CURRENT_SOURCE_DIR}/inc)
```

## prj.conf
```kconfig
# Sensor module
CONFIG_SENSOR=y

# Logger module
CONFIG_LOG=y
# Set default log level to Info for all modules
CONFIG_LOG_DEFAULT_LEVEL=3

# Button and LED library
CONFIG_DK_LIBRARY=y

# Bluetooth LE
CONFIG_BT=y

# Bluetooth Peripheral role
CONFIG_BT_PERIPHERAL=y
CONFIG_BT_DEVICE_NAME_DYNAMIC=y
CONFIG_BT_DEVICE_NAME="ENV_NODE"

# Watchdog
CONFIG_WATCHDOG=y
CONFIG_WDT_NRFX=y
```

## src/main.c
```c
#include <zephyr/kernel.h>           // k_sem_take
#include <zephyr/logging/log.h>      // LOG_MODULE_REGISTER
#include <zephyr/drivers/watchdog.h> // wdt_install_timeout, wdt_feed

#include "temp_sensor.h" // TempSensorInit, TempSensorRead
#include "app_timer.h"   // TimerInit, TimerGetSemaphore
#include "ble_service.h" // BLEInit, BLENotify

LOG_MODULE_REGISTER(main, LOG_LEVEL_DBG);

#define WDT_TIMEOUT_MS (MAX_INTERVAL_MS * 2)

static const struct device *wdt = DEVICE_DT_GET(DT_NODELABEL(wdt0));

int main(void)
{
    int ret;
    int32_t temperature;
    int wdt_channel;

    static const struct wdt_timeout_cfg wdt_cfg = {
        .window.min = 0,
        .window.max = WDT_TIMEOUT_MS, // 20 seconds in ms
        .callback = NULL,             // NULL = reset immediately on timeout
        .flags = WDT_FLAG_RESET_SOC,  // Reset the entire SoC on timeout
    };

    wdt_channel = wdt_install_timeout(wdt, &wdt_cfg);
    if (0 > wdt_channel)
    {
        LOG_ERR("Failed to install watchdog timeout: %d", wdt_channel);
        return wdt_channel;
    }

    ret = wdt_setup(wdt, WDT_OPT_PAUSE_HALTED_BY_DBG);
    if (0 > ret)
    {
        LOG_ERR("Failed to setup watchdog: %d", ret);
        return ret;
    }

    ret = TempSensorInit();
    if (0 > ret)
    {
        LOG_ERR("Failed to initialize temperature sensor: %d", ret);
        return ret;
    }

    TimerInit();

    ret = BLEInit();

    if (ret)
    {
        LOG_ERR("Failed to initialize BLE stack: %d", ret);
        return ret;
    }

    while (true)
    {
        k_sem_take(TimerGetSemaphore(), K_FOREVER);
        ret = TempSensorRead(&temperature);
        if (0 > ret)
        {
            LOG_ERR("Failed to read temperature sensor: %d", ret);
        }
        else
        {
            int32_t t = temperature;
            int32_t abs_frac = (t < 0 ? -t : t) % 100;
            LOG_DBG("Current temperature: %s%d.%02d C", t < 0 ? "-" : "", (t < 0 ? -t : t) / 100, abs_frac);

            t = TempSensorGetMin();
            abs_frac = (t < 0 ? -t : t) % 100;
            LOG_DBG("Min temperature: %s%d.%02d C", t < 0 ? "-" : "", (t < 0 ? -t : t) / 100, abs_frac);

            t = TempSensorGetMax();
            abs_frac = (t < 0 ? -t : t) % 100;
            LOG_DBG("Max temperature: %s%d.%02d C", t < 0 ? "-" : "", (t < 0 ? -t : t) / 100, abs_frac);

            ret = BLENotify(temperature);
            if (ret && ret != -EACCES)
            {
                LOG_WRN("Failed to notify: %d", ret);
            }
        }

        wdt_feed(wdt, wdt_channel);
        LOG_DBG("Watchdog fed successfully");
    }
    return 0;
}
```

## inc/app_timer.h
```c
#ifndef APP_TIMER_H_
#define APP_TIMER_H_

#include <zephyr/kernel.h>
#include <stdint.h> // uint32_t

#define MAX_INTERVAL_MS 10000
#define MIN_INTERVAL_MS 200
#define DEFAULT_INTERVAL_MS 1000

/**
 * @brief Initialize the application timer with the default interval.
 *        Starts the periodic timer immediately.
 */
void TimerInit(void);

/**
 * @brief Set (or update) the application timer interval.
 *        Restarts the timer from zero with the new period.
 * @param interval_ms The timer interval in milliseconds.
 *                    Must be in range [MIN_INTERVAL_MS, MAX_INTERVAL_MS];
 *                    the caller is responsible for validation.
 */
void TimerSetInterval(uint32_t interval_ms);

/**
 * @brief Get the semaphore that is signaled on every timer expiry.
 *        Use k_sem_take() on this to block until the next sample tick.
 * @return Pointer to the timer semaphore.
 */
struct k_sem *TimerGetSemaphore(void);

/**
 * @brief Get the current timer interval.
 * @return The timer interval in milliseconds.
 */
uint32_t TimerGetInterval(void);

#endif // APP_TIMER_H_
```

## inc/ble_service.h
```c
#ifndef BLE_SERVICE_H_
#define BLE_SERVICE_H_

#include <stdint.h> // uint32_t

/** @brief ENV_NODE Service UUID. */
#define BT_UUID_ENV_NODE_SERVICE_VAL \
    BT_UUID_128_ENCODE(0x9e844024, 0x1935, 0x465a, 0x94c7, 0xc82cbd35ecc1)

/** @brief TEMPERATURE Characteristic UUID. */
#define BT_UUID_ENV_NODE_TEMPERATURE_VAL \
    BT_UUID_128_ENCODE(0x9e844025, 0x1935, 0x465a, 0x94c7, 0xc82cbd35ecc1)

/** @brief INTERVAL Characteristic UUID. */
#define BT_UUID_ENV_NODE_INTERVAL_VAL \
    BT_UUID_128_ENCODE(0x9e844026, 0x1935, 0x465a, 0x94c7, 0xc82cbd35ecc1)

#define BT_UUID_ENV_NODE_SERVICE BT_UUID_DECLARE_128(BT_UUID_ENV_NODE_SERVICE_VAL)
#define BT_UUID_ENV_NODE_TEMPERATURE BT_UUID_DECLARE_128(BT_UUID_ENV_NODE_TEMPERATURE_VAL)
#define BT_UUID_ENV_NODE_INTERVAL BT_UUID_DECLARE_128(BT_UUID_ENV_NODE_INTERVAL_VAL)

/**
 * @brief Initialize the Bluetooth low energy connection.
 *  initialize BLE stack, start advertising
 * @return 0 on success or negative error code on failure.
 */
int BLEInit(void);

/**
 * @brief Send temperature notification to connected device.
 * @param temperature The temperature value to send in Celsius multiplied by 100 (e.g. 25.123C would be 25123).
 * note: the input temperature is a fixed-point representation to avoid using floating-point arithmetic.
 * need to divide by 100 to get the actual temperature in Celsius.
 */
int BLENotify(int32_t temperature);

#endif // BLE_SERVICE_H_
```

## inc/temp_sensor.h
```c
#ifndef TEMP_SENSOR_H_
#define TEMP_SENSOR_H_

#include <stdint.h> // int32_t

/**
 * @brief Initialize the temperature sensor.
 * @return 0 on success or negative error code on failure.
 */
int TempSensorInit(void);

/**
 * @brief Read the internal temperature sensor on the board.
 * @param[out] out_temp The output temperature in Celsius multiplied by 100(e.g. 25.12 C is represented as 2512).
 *Divide by 100 to get the actual temperature in Celsius.
 *Note: min/max tracking is updated on every successful read.
 *TempSensorGetMin/Max() return INT32_MAX/INT32_MIN until
 *the first successful read.
 * @return 0 on success or negative error code on failure.
 */
int TempSensorRead(int32_t *out_temp);

/**
 * @brief Get the minimum temperature recorded since boot.
 * @return Minimum temperature in Celsius multiplied by 100.
 *         Returns INT32_MAX if no successful read has occurred yet.
 */
int32_t TempSensorGetMin(void);

/**
 * @brief Get the maximum temperature recorded since boot.
 * @return Maximum temperature in Celsius multiplied by 100.
 *         Returns INT32_MIN if no successful read has occurred yet.
 */
int32_t TempSensorGetMax(void);

#endif /* TEMP_SENSOR_H_ */
```

## src/app_timer.c
```c
#include <zephyr/logging/log.h> //LOG_MODULE_REGISTER

#include "app_timer.h"

static void timer_expiry_handler(struct k_timer *timer);

LOG_MODULE_REGISTER(app_timer, LOG_LEVEL_DBG);

K_SEM_DEFINE(timer_sem, 0, 1);
K_TIMER_DEFINE(app_timer, timer_expiry_handler, NULL);

static uint32_t timer_interval_ms = DEFAULT_INTERVAL_MS; // Default interval of 1 second

void TimerInit(void)
{
    TimerSetInterval(timer_interval_ms);
    LOG_INF("Application timer initialized successfully");
}

void TimerSetInterval(uint32_t interval_ms)
{
    LOG_INF("Application timer interval set to %u ms", interval_ms);
    if (interval_ms < MIN_INTERVAL_MS || interval_ms > MAX_INTERVAL_MS)
    {
        LOG_ERR("Rejected interval %u ms (allowed: %u-%u ms), Interval remain as is.", interval_ms, MIN_INTERVAL_MS, MAX_INTERVAL_MS);
        return;
    }
    timer_interval_ms = interval_ms;
    k_timer_start(&app_timer, K_MSEC(interval_ms), K_MSEC(interval_ms));
}

struct k_sem *TimerGetSemaphore(void)
{
    return &timer_sem;
}

uint32_t TimerGetInterval(void)
{
    return timer_interval_ms;
}

/* helper function that run every time the timer expires */
static void timer_expiry_handler(struct k_timer *timer)
{
    k_sem_give(&timer_sem);
}
```

## src/ble_service.c
```c
#include <zephyr/bluetooth/bluetooth.h> // bt_enable
#include <zephyr/bluetooth/conn.h>      // BT_LE_ADV_CONN
#include <zephyr/bluetooth/gatt.h>      // bt_gatt_notify
#include <zephyr/logging/log.h>         // LOG_MODULE_REGISTER
#include <zephyr/sys/atomic.h>          // atomic_t, atomic_set, atomic_get
#include <zephyr/sys/util.h>            // memcpy
#include <dk_buttons_and_leds.h>        // dk_set_led_on
#include <sys/types.h>                  // ssize_t

#include "ble_service.h" // BLEInit, BLENotify
#include "app_timer.h"   // TimerGetInterval

LOG_MODULE_REGISTER(ble_controller, LOG_LEVEL_DBG);

#define BASE_DEVICE_NAME CONFIG_BT_DEVICE_NAME
#define DEVICE_NAME_LEN (sizeof(BASE_DEVICE_NAME) - 1)

/* Dynamic suffix format: '_' + 4 hex chars + null terminator = 6 extra bytes */
#define DEVICE_NAME_SUFFIX_LEN 6
#define DEVICE_NAME_BUF_LEN (DEVICE_NAME_LEN + DEVICE_NAME_SUFFIX_LEN)
#define CON_STATUS_LED DK_LED2

/*
 * Index of the Temperature characteristic *value* attribute within env_node_svc.attrs[].
 * Layout: [0]=primary service, [1]=char declaration, [2]=char value, [3]=CCC,
 *         [4]=interval char declaration, [5]=interval char value.
 * If attributes are reordered this MUST be updated accordingly.
 */
#define TEMP_CHRC_ATTR_IDX 2

/*
 * Preferred BLE connection parameters requested from the central after connecting.
 *
 * Rationale:
 *   - interval_min = 100 ms, interval_max = 500 ms (units of 1.25 ms → 80 / 400):
 *       The device samples at 200 ms–10 s. A 100–500 ms connection interval means
 *       notifications are delivered within at most one interval of their sample tick,
 *       while still saving significant radio-on time vs the default 7.5 ms interval.
 *   - latency = 0: The peripheral must stay responsive every event to receive
 *       interval WRITE commands from the central without delay.
 *   - timeout = 4000 ms (400 × 10 ms):
 *       Must satisfy: timeout > interval_max × (latency + 1) × 2
 *       → 4000 > 500 × 1 × 2 = 1000 ms  ✓
 *       Gives enough headroom for a phone screen-off radio duty-cycle.
 *
 * Note: These are *preferred* parameters. The central (phone) is not obligated
 * to accept them. The negotiated values are logged in on_le_param_updated().
 */
#define CONN_INTERVAL_MIN_UNITS BT_GAP_MS_TO_CONN_INTERVAL(100) /* 80  × 1.25 ms = 100 ms */
#define CONN_INTERVAL_MAX_UNITS BT_GAP_MS_TO_CONN_INTERVAL(500) /* 400 × 1.25 ms = 500 ms */
#define CONN_LATENCY 0
#define CONN_TIMEOUT_UNITS 400 /* 400 × 10 ms = 4000 ms */

static const struct bt_le_conn_param preferred_conn_params =
    BT_LE_CONN_PARAM_INIT(CONN_INTERVAL_MIN_UNITS,
                          CONN_INTERVAL_MAX_UNITS,
                          CONN_LATENCY,
                          CONN_TIMEOUT_UNITS);

/*
 * These flags are written from BT stack callbacks (BT thread context)
 * and read from the main application thread. atomic_t provides lock-free,
 * race-free access without needing a mutex.
 */
static atomic_t is_connected = ATOMIC_INIT(0);
static atomic_t is_notifications_enabled = ATOMIC_INIT(0);
static atomic_t current_temperature = ATOMIC_INIT(0);

static struct k_work adv_work;

/*
 * device_name is populated by SetDynamicDeviceName() before advertising starts.
 */
static char device_name[DEVICE_NAME_BUF_LEN];

static const struct bt_data ad[] = {
    BT_DATA_BYTES(BT_DATA_FLAGS, BT_LE_AD_GENERAL | BT_LE_AD_NO_BREDR),
};

static struct bt_data sd[] = {
    BT_DATA(BT_DATA_NAME_COMPLETE, device_name, DEVICE_NAME_BUF_LEN),
};

static void adv_work_handler(struct k_work *work)
{
    int err = bt_le_adv_start(BT_LE_ADV_CONN_FAST_1, ad, ARRAY_SIZE(ad), sd, ARRAY_SIZE(sd));

    if (err)
    {
        LOG_ERR("Advertising failed to start (err %d)", err);
        return;
    }

    LOG_INF("Advertising successfully started");
}

static void advertising_start(void)
{
    k_work_submit(&adv_work);
}

static void recycled_cb(void)
{
    LOG_INF("Connection object available from previous conn. Disconnect is complete!");
    advertising_start();
}

static void on_connected(struct bt_conn *conn, uint8_t err)
{
    if (err)
    {
        LOG_ERR("Connection failed (err %u)", err);
        return;
    }

    LOG_INF("Connected");
    atomic_set(&is_connected, 1);
    dk_set_led_on(CON_STATUS_LED);

    /*
     * Request preferred connection parameters from the central.
     * This is advisory — the central (phone) may accept, modify, or reject.
     * The outcome is logged in on_le_param_updated() below.
     */
    err = bt_conn_le_param_update(conn, &preferred_conn_params);
    if (err)
    {
        LOG_WRN("Connection parameter update request failed (err %d)", err);
    }
}

static void on_disconnected(struct bt_conn *conn, uint8_t reason)
{
    LOG_INF("Disconnected (reason %u)", reason);
    atomic_set(&is_connected, 0);
    atomic_set(&is_notifications_enabled, 0);
    dk_set_led_off(CON_STATUS_LED);
}

/*
 * Called when the central proposes new connection parameters.
 * Returning true accepts them unconditionally.
 */
static bool on_le_param_req(struct bt_conn *conn, struct bt_le_conn_param *param)
{
    if (param->interval_min < CONN_INTERVAL_MIN_UNITS || param->interval_max > CONN_INTERVAL_MAX_UNITS)
    {
        LOG_WRN("Central requests invalid conn params: interval [%u, %u] latency %u timeout %u",
                param->interval_min, param->interval_max,
                param->latency, param->timeout);
        return false; /* reject */
    }

    LOG_DBG("Central requests conn params: interval [%u, %u] latency %u timeout %u",
            param->interval_min, param->interval_max,
            param->latency, param->timeout);
    return true; /* accept */
}

/*
 * Called after connection parameters have been successfully updated.
 * Logs the actual negotiated values so you can verify in RTT/UART logs.
 */
static void on_le_param_updated(struct bt_conn *conn, uint16_t interval,
                                uint16_t latency, uint16_t timeout)
{
    /* interval is in units of 1.25 ms */
    LOG_INF("Conn params updated: interval %u (%.2f ms), latency %u, timeout %u ms",
            interval, (double)interval * 1.25, latency, timeout * 10);
}

BT_CONN_CB_DEFINE(connection_callbacks) = {
    .connected = on_connected,
    .disconnected = on_disconnected,
    .recycled = recycled_cb,
    .le_param_req = on_le_param_req,         /* central requests param change   */
    .le_param_updated = on_le_param_updated, /* negotiation completed, log result */
};

static ssize_t ReadTemperature(struct bt_conn *conn, const struct bt_gatt_attr *attr, void *buf, uint16_t len, uint16_t offset)
{
    int32_t temp = (int32_t)atomic_get(&current_temperature);

    return bt_gatt_attr_read(conn, attr, buf, len, offset, &temp, sizeof(temp));
}

static void OnCccChanged(const struct bt_gatt_attr *attr, uint16_t value)
{
    atomic_set(&is_notifications_enabled, (value == BT_GATT_CCC_NOTIFY) ? 1 : 0);
    LOG_INF("Temperature notifications %s", atomic_get(&is_notifications_enabled) ? "enabled" : "disabled");
}

static ssize_t ReadInterval(struct bt_conn *conn, const struct bt_gatt_attr *attr, void *buf, uint16_t len, uint16_t offset)
{
    uint32_t interval = TimerGetInterval();

    return bt_gatt_attr_read(conn, attr, buf, len, offset, &interval, sizeof(interval));
}

static ssize_t WriteInterval(struct bt_conn *conn, const struct bt_gatt_attr *attr, const void *buf, uint16_t len, uint16_t offset, uint8_t flags)
{
    uint32_t new_interval;

    if (len != sizeof(uint32_t))
    {
        LOG_ERR("Invalid interval length: %u (expected %zu)", len, sizeof(uint32_t));
        return BT_GATT_ERR(BT_ATT_ERR_INVALID_ATTRIBUTE_LEN);
    }

    memcpy(&new_interval, buf, sizeof(new_interval));

    if (new_interval < MIN_INTERVAL_MS || new_interval > MAX_INTERVAL_MS)
    {
        LOG_WRN("Rejected interval %u ms (allowed: %u-%u ms)", new_interval,
                MIN_INTERVAL_MS, MAX_INTERVAL_MS);
        return BT_GATT_ERR(BT_ATT_ERR_VALUE_NOT_ALLOWED);
    }

    TimerSetInterval(new_interval);
    return len;
}

BT_GATT_SERVICE_DEFINE(env_node_svc,
                       BT_GATT_PRIMARY_SERVICE(BT_UUID_ENV_NODE_SERVICE),

                       BT_GATT_CHARACTERISTIC(BT_UUID_ENV_NODE_TEMPERATURE,
                                              BT_GATT_CHRC_READ | BT_GATT_CHRC_NOTIFY,
                                              BT_GATT_PERM_READ,
                                              ReadTemperature, NULL, NULL),
                       BT_GATT_CCC(OnCccChanged, BT_GATT_PERM_READ | BT_GATT_PERM_WRITE),

                       BT_GATT_CHARACTERISTIC(BT_UUID_ENV_NODE_INTERVAL,
                                              BT_GATT_CHRC_READ | BT_GATT_CHRC_WRITE,
                                              BT_GATT_PERM_READ | BT_GATT_PERM_WRITE,
                                              ReadInterval, WriteInterval, NULL), );

static void SetDynamicDeviceName(void)
{
    int err;
    bt_addr_le_t addr[1];
    size_t count = 1;

    bt_id_get(addr, &count);

    if (count == 0)
    {
        LOG_ERR("Failed to get BT address, keeping default name: %s", BASE_DEVICE_NAME);
        return;
    }

    uint8_t last_byte = addr[0].a.val[0];
    uint8_t prev_byte = addr[0].a.val[1];

    snprintf(device_name, sizeof(device_name), "%s_%02X%02X", BASE_DEVICE_NAME, prev_byte, last_byte);

    /* Update scan data length to match the actual dynamic name length */
    sd[0].data_len = strlen(device_name);

    err = bt_set_name(device_name);
    if (err)
    {
        LOG_ERR("Failed to set device name (err %d)", err);
    }
    else
    {
        LOG_INF("Device name set to: %s", device_name);
    }
}

int BLEInit(void)
{
    int err;

    err = dk_leds_init();
    if (err)
    {
        LOG_ERR("LEDs init failed (err %d)", err);
        return err;
    }

    err = bt_enable(NULL);
    if (err)
    {
        LOG_ERR("Bluetooth init failed (err %d)", err);
        return err;
    }

    SetDynamicDeviceName();

    k_work_init(&adv_work, adv_work_handler);
    advertising_start();

    return 0;
}

int BLENotify(int32_t temperature)
{
    if (!atomic_get(&is_connected))
    {
        LOG_DBG("Cannot send notification: no device connected");
        return -EACCES;
    }

    if (!atomic_get(&is_notifications_enabled))
    {
        LOG_DBG("Cannot send notification: notifications disabled by client");
        return -EACCES;
    }

    atomic_set(&current_temperature, temperature);

    return bt_gatt_notify(NULL, &env_node_svc.attrs[TEMP_CHRC_ATTR_IDX],
                          &temperature, sizeof(temperature));
}
```

## src/temp_sensor.c
```c
#include <zephyr/kernel.h>         // k_sleep
#include <zephyr/drivers/sensor.h> // device_is_ready, sensor_sample_fetch
#include <zephyr/logging/log.h>    // LOG_MODULE_REGISTER

#include "temp_sensor.h"

LOG_MODULE_REGISTER(temp_sensor, LOG_LEVEL_DBG);

#define FILTER_WINDOW_SIZE 10

static int32_t min_temp = INT32_MAX;
static int32_t max_temp = INT32_MIN;

static const struct device *temp_dev;

static int32_t ApplyMovingAverage(int32_t new_sample);

int TempSensorInit(void)
{
    temp_dev = DEVICE_DT_GET(DT_NODELABEL(temp));
    if (!device_is_ready(temp_dev))
    {
        LOG_ERR("Temperature sensor device not ready");
        return -ENODEV;
    }

    LOG_INF("Temperature sensor initialized successfully");
    return 0;
}

int TempSensorRead(int32_t *out_temp)
{
    int ret;
    struct sensor_value sensor_val;

    ret = sensor_sample_fetch(temp_dev);
    if (0 > ret)
    {
        LOG_ERR("Failed to fetch temperature sensor sample: %d", ret);
        return ret;
    }

    ret = sensor_channel_get(temp_dev, SENSOR_CHAN_DIE_TEMP, &sensor_val);
    if (0 > ret)
    {
        LOG_ERR("Failed to get temperature sensor channel value: %d", ret);
        return ret;
    }

    *out_temp = ApplyMovingAverage(sensor_val.val1 * 100 + (sensor_val.val2 / 10000));

    LOG_DBG("Read temperature: %d.%02d C", sensor_val.val1, sensor_val.val2 / 10000);

    min_temp = (*out_temp < min_temp) ? *out_temp : min_temp;
    max_temp = (*out_temp > max_temp) ? *out_temp : max_temp;

    return 0;
}

int32_t TempSensorGetMin(void)
{
    return min_temp;
}

int32_t TempSensorGetMax(void)
{
    return max_temp;
}

/**
 * Applies a simple moving average filter to the incoming temperature samples to smooth out noise.
 * Maintains a circular buffer of the last FILTER_WINDOW_SIZE samples and returns the average.
 * This helps to provide more stable temperature readings at the cost of some responsiveness to rapid changes.
 * filter_head always points to the NEXT write slot.
 * While filling (filter_count < FILTER_WINDOW_SIZE), only indices [0, filter_count) are valid.
 * Once full, all FILTER_WINDOW_SIZE slots are valid and the oldest entry is silently overwritten on each new sample.
 */
static int32_t ApplyMovingAverage(int32_t new_sample)
{
    static int32_t filter_buffer[FILTER_WINDOW_SIZE];
    static uint8_t filter_head = 0;
    static uint8_t filter_count = 0;
    int64_t sum = 0;

    filter_buffer[filter_head] = new_sample;
    filter_head = (filter_head + 1) % FILTER_WINDOW_SIZE;

    if (filter_count < FILTER_WINDOW_SIZE)
    {
        filter_count++;
    }

    for (uint8_t i = 0; i < filter_count; i++)
    {
        sum += filter_buffer[i];
    }

    return (int32_t)(sum / filter_count);
}
```
